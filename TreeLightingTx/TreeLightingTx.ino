// OLED
#include <Adafruit_SSD1306.h>
#include <splash.h>
#include <Wire.h>
#include <Adafruit_GFX.h>
#define SCREEN_WIDTH 128
#define SCREEN_HEIGHT 32
Adafruit_SSD1306 display(SCREEN_WIDTH, SCREEN_HEIGHT, &Wire, -1);

//logos
const unsigned char HIP [] PROGMEM = {
  // 'HIP logo, 128x32px
  0xff, 0xff, 0xff, 0xff, 0xff, 0xff, 0xf0, 0xff, 0xff, 0xff, 0xff, 0xff, 0xff, 0xff, 0xff, 0xff, 
  0xff, 0xff, 0xff, 0xff, 0xff, 0xff, 0x00, 0x00, 0x08, 0x0f, 0xff, 0xff, 0xff, 0xff, 0xff, 0xff, 
  0xff, 0xff, 0xff, 0xff, 0xff, 0xf8, 0x00, 0x00, 0x00, 0x01, 0xff, 0xff, 0xff, 0xff, 0xff, 0xff, 
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  0xff, 0xff, 0xff, 0xff, 0xff, 0xff, 0xff, 0xff, 0xff, 0xff, 0xff, 0xff, 0xff, 0xff, 0xff, 0xff
};
const unsigned char logo [] PROGMEM = {
  // '1200px-Six_Flags_logo, 128x32px
  0x00, 0x00, 0x00, 0x00, 0x00, 0x00, 0x00, 0x00, 0x00, 0x00, 0x00, 0x00, 0x00, 0x00, 0x00, 0x00,
  0x00, 0x00, 0x00, 0x00, 0x00, 0x00, 0x00, 0x00, 0x00, 0x00, 0x00, 0x00, 0x00, 0x00, 0x00, 0x00,
  0x00, 0x00, 0x00, 0x00, 0x00, 0x00, 0x00, 0x00, 0x00, 0x00, 0x00, 0x00, 0x00, 0x00, 0x00, 0x00,
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  0x00, 0x00, 0x00, 0x00, 0x00, 0x00, 0x00, 0x00, 0x00, 0x00, 0x00, 0x00, 0x00, 0x00, 0x00, 0x00
};

// Wireless
#include <SPI.h> // to communicate with the module
#include <nRF24L01.h> // library
#include <RF24.h>
RF24 radio(7, 8);
const byte numRx = 5;
const byte rxAddress[numRx][6] = {
  {'R', 'x', '6', 'F', '1'},
  {'R', 'x', '6', 'F', '2'},
  {'R', 'x', '6', 'F', '3'},
  {'R', 'x', '6', 'F', '4'},
  {'R', 'x', '6', 'F', '5'}
};
bool rxState[numRx];
const byte channel = "108";
const char lightsOn[32] = "LightsOn";
const char lightsOff[32] = "LightsOff";
const char hello[32] = "ping";
//String dataToSend = "";

// Status system
char lastRx[10] = "ARMED";

// Timing
long lastTx = 0;

// Pin Setup
const int onPin = 3;
const int offPin = 4;
const int armPin = 5;

// transmission function
void transmit(int command) {
  for (byte n = 0; n < numRx; n++) {
    radio.stopListening();
    radio.openWritingPipe(rxAddress[n]);
    //delay(30);
    bool rslt;
    if (command == 1) {
      //strcpy(dataToSend,"LightsOn");
      rslt = radio.write( &lightsOn, sizeof(lightsOn));
    }
    else if (command == 2) {
      //strcpy(dataToSend,"LightsOff");
      rslt = radio.write( &lightsOff, sizeof(lightsOff));
    }
    else {
      //strcpy(dataToSend,"ping");
      rslt = radio.write( &hello, sizeof(hello));
    }
    //Serial.println(dataToSend);
    rxState[n] = rslt;
  }
}

void txTest() {
  transmit(0);
  display.clearDisplay();
  display.setTextSize(1);
  display.setCursor(0, 0);
  display.setTextColor(WHITE);
  int numErrors = 0;
  for (byte n = 0; n < numRx; n++) {
    if (!rxState[n]) {
      display.println("Rx " + String(n + 1) + " Missing");
      numErrors = numErrors + 1;
    }
  }
  if (numErrors == 0) {
    display.setTextSize(2);
    display.write("");
    //display.display();
  }
  display.display();
}

void setup() {
  Serial.begin(9600);
  // Start Radio
  radio.begin();
  radio.setPALevel(RF24_PA_MAX);
  //radio.setChannel(channel);
  radio.setRetries(3, 10);
  //radio.setDataRate(RF24_250KBPS); // Lower rate, longer distance
  if (!display.begin(SSD1306_SWITCHCAPVCC, 0x3C)) { // Address 0x3D for 128x64
    Serial.println(F("SSD1306 allocation failed"));
    for (;;);
  }
  display.clearDisplay();
  display.drawBitmap(0, 0, logo, 128, 32, WHITE);
  display.display();
  delay(1000);
  display.clearDisplay();
  display.setTextSize(1);
  display.setCursor(0, 0);
  display.setTextColor(WHITE);
  display.println("Powered by");
  display.println("Firehound");
  display.println("Production");
  display.println("Solutions");
  display.display();
  delay(1000);
  display.clearDisplay();

  // start inputs
  pinMode(onPin, INPUT_PULLUP);
  pinMode(offPin, INPUT_PULLUP);
  pinMode(armPin, INPUT_PULLUP);


  // Establish starting statuses
  for (byte i = 0; i < numRx; i++) {
    rxState[i] = 0;
  }
}

void loop() {
  // put your main code here, to run repeatedly:
  if (digitalRead(armPin) == HIGH) {
    display.clearDisplay();
    display.drawBitmap(0, 0, HIP, 128, 32, WHITE);
    display.display();
  }
  else {
    display.clearDisplay();
    display.setTextSize(2);
    display.setCursor(0, 0);
    display.setTextColor(WHITE);
    display.write(lastRx);
    display.display();
    if (digitalRead(onPin) == LOW) {
      transmit(1);
      lastRx[10] = "ON";
    }
    else if (digitalRead(offPin) == LOW) {
      transmit(2);
      lastRx[10] = "OFF";
    }
    else {
      // loop and wait for input!
    }
  }
}

/*
  if (radio.available()) {
  char text[32] = "";
  radio.read(&text, sizeof(text));
  display.clearDisplay();
  display.setTextSize(2);
  display.setCursor(0,0);
  display.setTextColor(WHITE);
  display.println(text);
  display.display();
  lastRx = millis();
  Serial.println(text);
  }
  else {
  if(millis()-lastRx >=500) {
    display.clearDisplay();
    display.setCursor(0,0);
    display.setTextSize(4);
    display.setTextColor(WHITE);
    display.println(":(");
    display.display();
  }
  }*/
